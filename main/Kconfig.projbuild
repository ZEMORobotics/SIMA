## main/Kconfig.projbuild
```kconfig
menu "ZeMo CoAP Client Configuration"

    config WIFI_SSID
      string "Target SSID"
      default "Default_Network"
      help
        Target ssid for the wanted wifi network.

    config WIFI_PASS
      string "Target Password"
      default "12345678"
      help
        Target password of the wanted wifi network.

    config EXAMPLE_TARGET_DOMAIN_URI
        string "Target Uri"
        default "coaps://californium.eclipseprojects.io"
        help
            Target uri for the example to use. Use coaps:// prefix for encrypted traffic
            using Pre-Shared Key (PSK) or Public Key Infrastructure (PKI).

    config EXAMPLE_COAP_PSK_KEY
        string "Preshared Key (PSK) to used in the connection to the CoAP server"
        depends on COAP_MBEDTLS_PSK
        default "sesame"
        help
            The Preshared Key to use to encrypt the communicatons. The same key must be
            used at both ends of the CoAP connection, and the CoaP client must request
            an URI prefixed with coaps:// instead of coap:// for DTLS to be used.

    config EXAMPLE_COAP_PSK_IDENTITY
        string "PSK Client identity (username)"
        depends on COAP_MBEDTLS_PSK
        default "password"
        help
            The identity (or username) to use to identify to the CoAP server which
            PSK key to use.

endmenu
```

## managed_components/path_finding/Kconfig
```kconfig
menu "Path Finder Configuration"

  config START_NODE_NUMBER
    int "Set starting node of the path"
    default 0
    help
      Set the starting node of the path at the match beginning

  config  END_NODE_NUMBER
    int "Set end node of the PATH"
    default 0
    help
      Set the ending node of the path at the match beginning

  config ADD_INFLATION
    bool "Add inflation layer to pathfinding"
    default n
    help
      Adds inflation to nodes close to obstacles
  
  config INFLATION_DEPTH
    int "Choose number of inflated nodes"
    default 2
    help
      Number of nodes close to obstacles to be inflated

  config INFLATION_STEP
    int "F cost to be added per step"
    default 10
    help
      Number of immaginate step costs to be added to cost
  
endmenu
```
